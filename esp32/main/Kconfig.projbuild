## esp32/main/Kconfig.projbuild
```kconfig
# Based on the WiFi example of ESP-IDF.
menu "WiFi Configuration"

    config ESP_WIFI_SSID
        string "WiFi SSID"
        default "ssid"
        help
            SSID of the WiFi network to connect to.

    config ESP_WIFI_PASSWORD
        string "WiFi Password"
        default "password"
        help
            The WiFi network's password.
endmenu

menu "Remote Server Configuration"

    config ESP_REMOTE_SERVER_IP
        string "Remote Server IP Address"
        default "127.0.0.1"
        help
            The IP address of the remote server which stores alerts.

    config ESP_REMOTE_SERVER_PORT
        string "Remote Server Port Number"
        default "80"
        help
            The port number of the remote server which stores alerts.

endmenu

menu "Firebase Authentication"

    config ESP_AUTH_EMAIL
        string "Firebase Application Email"
        default "test@example.com"
        help
            The email used to log into the Firebase application for sending notifications.
    
    config ESP_AUTH_PASSWORD
        string "Firebase Application Password"
        default "testPassword"
        help
            The password used to log into the Firebase application for sending notifications.

endmenu
```

## main/Kconfig.projbuild
```kconfig
# Based on the WiFi example of ESP-IDF.
menu "WiFi Configuration"

    config ESP_WIFI_SSID
        string "WiFi SSID"
        default "ssid"
        help
            SSID of the WiFi network to connect to.

    config ESP_WIFI_PASSWORD
        string "WiFi Password"
        default "password"
        help
            The WiFi network's password.
endmenu

menu "Remote Server Configuration"

    config ESP_REMOTE_SERVER_IP
        string "Remote Server IP Address"
        default "127.0.0.1"
        help
            The IP address of the remote server which stores alerts.

    config ESP_REMOTE_SERVER_PORT
        string "Remote Server Port Number"
        default "80"
        help
            The port number of the remote server which stores alerts.
endmenu
```
